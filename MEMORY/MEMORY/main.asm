; MEMORY.asm
; Created: 7/18/2020 10:51:01 AM
; Author : LUIS_QV
.org 0x0000

LDI r16,$FF
OUT SPL, r16
LDI r16,$08
OUT SPH, r16


; Replace with your application code
LDI r20,0x80//DECLARCION DE REGISTROS0x20
LDI r21,0x00//DECLARCION DE REGISTROS
OUT DDRB,r20//CONFIGURACION DE PUERTOS I/O
RJMP HOME//SALTO A HOME


/*SUB RUTINA TIMER 0*/
PERIODO:
LDI r23,0x05//DECLARCION DE REGISTROS
LDI r24,0x00//DECLARCION DE REGISTROS
LDI r26,126//DECLARCION DE REGISTROS
OUT TCCR0B,r23
OUT TCNT0,r24
LOOP1:
IN r23,TCNT0
CPSE r23,r26
BRNE LOOP1
RET//RETORNO DE LA SUB-RUTINA TIMER 0
/*SUB RUTINA TIMER 0*/

HOME:
start:
OUT PORTB,r20
CALL PERIODO/*LLAMADA A LA SUB-RUTINA TIMER 0*/
OUT PORTB,r21
CALL PERIODO/*LLAMADA A LA SUB-RUTINA TIMER 0*/
NOP

rjmp start
