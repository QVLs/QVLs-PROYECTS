#ifndef I2C_AVR_328P
#define I2C_AVR_328P
#define BIT0 0
#define BIT1 1
void ERROR_I2C();
void START_COMUNICATION_I2C();
void DISLABLE_I2C(int VELOCIDAD_DEL_I2C,int TWPS_1,int TWPS_0);
void ENABLE_I2C_NOT_PULL_UP(int VELOCIDAD_DEL_I2C,int TWPS_1,int TWPS_0);
void ENABLE_I2C_PULL_UP(uint8_t VELOCIDAD_DEL_I2C,int TWPS_1,int TWPS_0);
void ESPERA_I2C();
uint8_t READ_I2C_ACK();
uint8_t READ_I2C_NACK();
uint8_t ESTATUS_I2C();
void STOP_COMUNICATION_I2C();
void WRITE_I2C(unsigned char ADDRESS_I2C_BIT_WRITE_BIT_READ);
uint8_t READ_I2C_ACK(){
TWCR=(BIT1<<TWINT)|(BIT1<<TWEN)|(BIT1<<TWEA);
return TWDR;}
uint8_t READ_I2C_NACK(){
TWCR=(BIT1<<TWINT)|(BIT1<<TWEN);
return TWDR;}
void WRITE_I2C(unsigned char ADDRESS_I2C_BIT_WRITE_BIT_READ){
TWDR=ADDRESS_I2C_BIT_WRITE_BIT_READ;
TWCR=(BIT1<<TWINT)|(BIT1<<TWEN);}
void START_COMUNICATION_I2C(void){	
TWCR=(BIT1<<TWINT)|(BIT1<<TWSTA)|(1<<TWEN);}
void ENABLE_I2C_PULL_UP(uint8_t VELOCIDAD_DEL_I2C,int TWPS_1,int TWPS_0){
DDRC&=(BIT0<<DDC4)|(BIT0<<DDC5);
PORTC|=(BIT1<<PORTC5)|(BIT1<<PORTC4);
if((TWPS_1==BIT0)&&(TWPS_0==BIT0)){
TWSR|=(BIT1<<TWPS0)|(BIT1<<TWPS1);}else{
if((TWPS_1==BIT0)&&(TWPS_0==BIT1)){
TWSR|=(BIT1<<TWPS0)|(BIT0<<TWPS1);}else{
if((TWPS_1==BIT1)&&(TWPS_0==BIT0)){
TWSR|=(BIT0<<TWPS0)|(BIT1<<TWPS1);}else{
if((TWPS_1==BIT1)&&(TWPS_0==BIT1)){
TWSR|=(BIT1<<TWPS0)|(BIT1<<TWPS1);}}}}
TWBR=VELOCIDAD_DEL_I2C;
TWCR|=(BIT1<<TWEN);}
void ENABLE_I2C_NOT_PULL_UP(int VELOCIDAD_DEL_I2C,int TWPS_1,int TWPS_0){
DDRC&=(BIT0<<DDC4)|(BIT0<<DDC5);
/*DDRC|=(1<<DDC3);*/
PORTC&=(BIT0<<PORTC5)|(BIT0<<PORTC4);
/*PORTC|=(1<<PORTC3);*/
if((TWPS_1==BIT0)&&(TWPS_0==BIT0)){
TWSR|=(BIT1<<TWPS0)|(BIT1<<TWPS1);}else{
if((TWPS_1==BIT0)&&(TWPS_0==BIT1)){
TWSR|=(BIT1<<TWPS0)|(BIT0<<TWPS1);}else{
if((TWPS_1==BIT1)&&(TWPS_0==BIT0)){
TWSR|=(BIT0<<TWPS0)|(BIT1<<TWPS1);}else{
if((TWPS_1==BIT1)&&(TWPS_0==BIT1)){
TWSR|=(BIT1<<TWPS0)|(BIT1<<TWPS1);}}}}
TWBR=VELOCIDAD_DEL_I2C;
TWCR|=(BIT1<<TWEN);}
void DISLABLE_I2C(int VELOCIDAD_DEL_I2C,int TWPS_1,int TWPS_0){
DDRC&=(BIT0<<DDC4)|(BIT0<<DDC5);
/*DDRC|=(1<<DDC3);*/
PORTC&=(BIT0<<PORTC5)|(BIT0<<PORTC4);
/*PORTC|=(1<<PORTC3);*/
if((TWPS_1==BIT0)&&(TWPS_0==BIT0)){
TWSR|=(BIT1<<TWPS0)|(BIT1<<TWPS1);}else{
if((TWPS_1==BIT0)&&(TWPS_0==BIT1)){
TWSR|=(BIT1<<TWPS0)|(BIT0<<TWPS1);}else{
if((TWPS_1==BIT1)&&(TWPS_0==BIT0)){
TWSR|=(BIT0<<TWPS0)|(BIT1<<TWPS1);}else{
if((TWPS_1==BIT1)&&(TWPS_0==BIT1)){
TWSR|=(BIT1<<TWPS0)|(BIT1<<TWPS1);}}}}
TWBR=VELOCIDAD_DEL_I2C;
TWCR=(BIT0<<TWEN);}
void ESPERA_I2C(void){
while(!(TWCR&(BIT1<<TWINT))){}}
void ERROR_I2C(void){}
uint8_t ESTATUS_I2C(void){
uint8_t DATE_ESTATUS_I2C;
DATE_ESTATUS_I2C=TWSR&0xf8;
ERROR_I2C();
return DATE_ESTATUS_I2C;}
void STOP_COMUNICATION_I2C(void){
TWCR=(BIT1<<TWINT)|(BIT1<<TWEN)|(BIT1<<TWSTO);}
#endif