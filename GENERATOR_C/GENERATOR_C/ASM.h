/*
 * IncFile1.h
 *
 * Created: 7/23/2020 10:33:32 AM
 *  Author: el_lu
 */


#ifndef INCFILE1_H_
#define INCFILE1_H_
.org 0x0000
LDI r16,0xFF
OUT SPL, r16
LDI r16,0x08
OUT SPH, r16
//DECLARCION DE REGISTROS
LDI r20,0x01
LDI r21,0x00
//DECLARCION DE REGISTROS
OUT DDRD,r20//CONFIGURACION DE PUERTOS I/O
RJMP HOME//SALTO A HOME
/*SUB RUTINA TIMER 0*/
PERIODO:
LDI r23,0x05//DECLARCION DE REGISTROS
LDI r24,0x00//DECLARCION DE REGISTROS
LDI r26,100//DECLARCION DE REGISTROS
OUT TCCR0B,r23
OUT TCNT0,r24
LOOP1:
IN r23,TCNT0
CPSE r23,r26
BRNE LOOP1
RET//RETORNO DE LA SUB-RUTINA TIMER 0
/*SUB RUTINA TIMER 0*/
HOME:
start:
OUT PORTD,r20
CALL PERIODO/*LLAMADA A LA SUB-RUTINA TIMER 0*/
OUT PORTD,r21
CALL PERIODO/*LLAMADA A LA SUB-RUTINA TIMER 0*/
NOP
rjmp start
#endif /* INCFILE1_H_ */