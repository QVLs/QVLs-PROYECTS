#ifndef SENSORES_AVR_328P
#define SENSORES_AVR_328P
#define VEOLTAJE_MAXIMO_PERMITIDO_SENSOR_0 1.2
#define VEOLTAJE_MAXIMO_PERMITIDO_SENSOR_1 2.5
#define VEOLTAJE_MAXIMO_PERMITIDO_SENSOR_2 1.5
#define RESOLUTION0 0.0029296875 //0.0048875855
#define BIT0 0
#define BIT1 1
uint16_t VAR_REGISTRO_ADC0=0;
uint16_t VAR_REGISTRO_ADC1=0;
uint16_t VAR_REGISTRO_ADC2=0;
float VAR_VOLTAJE_ENTRADA0=0;
float VAR_VOLTAJE_ENTRADA1=0;
float VAR_VOLTAJE_ENTRADA2=0;
int LUIS0=1;
int LUIS1=1;
int LUIS2=1;
int LUIS3=1;
void PAUSE_FLUJO(uint16_t DELAY,int CS_12,int CS_11,int CS_10);
void CONTROL_CONVERSOR_ANLOGICO_DIGITAL();
void SENSOR0();
void SENSOR1();
void SENSOR2();
void ALERTA();
void CONTROL_CONVERSOR_ANLOGICO_DIGITAL(){
/*DDRC=0x00;*/
DDRB=0x0F;/*NUMERO DE PUERTOS A UTILIZAR COMO CONVERTIDORES ANALOGICOS*/
/*	DDRD=0xFF;*/
/*  PORTD=0x05;*/
ADCSRA|=(BIT1<<ADPS0)|(BIT1<<ADPS1)|(BIT1<<ADPS0);
DIDR0|=(BIT1<<ADC2D)|(BIT1<<ADC1D)|(BIT1<<ADC0D);
TCCR1B|=(BIT1<<CS12)|(BIT0<<CS11)|(BIT0<<CS10);
TCNT1=BIT0;}
/*FUNCION DE RETARDO DEL FLUJO DE EJECUCION DDE INSTRUCCION DEL MICROCONTROLARDOR*/
void PAUSE_FLUJO(uint16_t DELAY,int CS_12,int CS_11,int CS_10){
int C_12=CS_12;
int C_11=CS_11;
int C_10=CS_10;
int TEMP=DELAY;
if ((C_12==BIT0)&&(C_11==BIT1)&&(C_10==BIT1)){TCCR1B=0x03;}else{
if((C_12==BIT0)&&(C_11==BIT1)&&(C_10==BIT0)){TCCR1B=0x02;}else{
if((C_12==BIT1)&&(C_11==BIT0)&&(C_10==BIT1)){TCCR1B=0x05;}else{
if((C_12==BIT1)&&(C_11==BIT1)&&(C_10==BIT0)){TCCR1B=0x04;}else{
if((C_12==BIT0)&&(C_11==BIT0)&&(C_10==BIT1)){TCCR1B=0x01;}}}}}
/*INDICADOR DEL VALOR DE PRESCALER*/
// if(TCCR1B&(BIT1<<CS12)){PORTB|=(BIT1<<PORTB4);}
// if(TCCR1B&(BIT1<<CS11)){PORTB|=(BIT1<<PORTB5);}
// if(TCCR1B&(BIT1<<CS10)){PORTB|=(BIT1<<PORTB6);}
/*INDICADOR DEL VALOR DE PRESCALER*/
TCNT1=BIT0;
while((TCNT1<TEMP)){}
TCNT1=BIT0;}

/*FUNCION DE RETARDO DEL FLUJO DE PROGRAMACION DEL MICROCONTROLARDOR*/


/*FUNCION QUE OPTIENE Y CONVIERTE LOS DATOS DEL VOLTAJE GENERADOS POR EL SENSOR0 */
void SENSOR0(){
ADMUX=0x00;
ADCSRA=(BIT1<<ADEN)|(BIT1<<ADSC);
while(ADCSRA&(BIT1<<ADSC)){}
ADCSRA&= ~(BIT1<<ADEN);
VAR_REGISTRO_ADC0=ADC;
VAR_VOLTAJE_ENTRADA0= (float)VAR_REGISTRO_ADC0*RESOLUTION0;
ADMUX &=(BIT0<<MUX0);
if(VAR_VOLTAJE_ENTRADA0 > VEOLTAJE_MAXIMO_PERMITIDO_SENSOR_0){
if (LUIS0==BIT1){LUIS0=BIT0;
/*PORTD|=(BIT1<<3);*/PORTB|=(BIT1<<PORTB0);}}
else{
if (LUIS0==BIT0){LUIS0=BIT1;
/*PORTD&=~(BIT1<<3);*/PORTB&=~(BIT1<<PORTB0);}}}
/*------------------------------------------------------------------*/


/*FUNCION QUE OPTIENE Y CONVIERTE LOS DATOS DEL VOLTAJE GENERADOS POR EL SENSOR1 */
void SENSOR1(){
ADMUX=0x01;
ADCSRA=(BIT1<<ADEN)|(BIT1<<ADSC);
while(ADCSRA&(BIT1<<ADSC)){}
ADCSRA&=~(BIT1<<ADEN);
VAR_REGISTRO_ADC1=ADC;
VAR_VOLTAJE_ENTRADA1=(float)VAR_REGISTRO_ADC1*RESOLUTION0;
ADMUX&=(BIT0<<MUX0);
if(VAR_VOLTAJE_ENTRADA1 > VEOLTAJE_MAXIMO_PERMITIDO_SENSOR_1){
if(LUIS1==BIT1){LUIS1=BIT0;
/*PORTD|=(2<<3);*/PORTB|=(BIT1<<PORTB1);}}
else{if (LUIS1==BIT0){LUIS1=1;
/*PORTD&=~(2<<3);*/PORTB&=~(BIT1<<PORTB1);}}}
/*------------------------------------------------------------------*/


/*FUNCION QUE OPTIENE Y CONVIERTE LOS DATOS DEL VOLTAJE GENERADOS POR EL SENSOR2 */
void SENSOR2(){
ADMUX=0x02;
ADCSRA=(BIT1<<ADEN)|(BIT1<<ADSC);
while(ADCSRA&(BIT1<<ADSC)){}
ADCSRA&=~(BIT1<<ADEN);
VAR_REGISTRO_ADC2=ADC;
VAR_VOLTAJE_ENTRADA2=(float)VAR_REGISTRO_ADC2*RESOLUTION0;
ADMUX &=(BIT0<<MUX1);
if(VAR_VOLTAJE_ENTRADA2 > VEOLTAJE_MAXIMO_PERMITIDO_SENSOR_2){	
if (LUIS2==BIT1){LUIS2=BIT0;
/*PORTD|=(3<<3);*/PORTB|=(BIT1<<PORTB2);}}
else{if(LUIS2==BIT0){LUIS2=BIT1;
/*PORTD&=~(3<<3);*/PORTB&=~(BIT1<<PORTB2);}}}

/*------------------------------------------------------------------*/
/*ESTA FUNCION DETECTA CUANDO LOS DOS SENSORES DE DE CALIDAD DE AIRE ALCANZAN VALORES ALTOS NO ACEPTABLES CONFIGURADOS PREVIAMENTE, LUEGO DE UN ANALISIS DE LOS VALORES OBTENIDOS POR LOS SENSORES EN PRUEBAS INDIVIDUALES*/
void ALERTA(){if((VAR_VOLTAJE_ENTRADA1 >= VEOLTAJE_MAXIMO_PERMITIDO_SENSOR_1) & (VAR_VOLTAJE_ENTRADA0 >= VEOLTAJE_MAXIMO_PERMITIDO_SENSOR_0)){
if(LUIS3==BIT1){LUIS3=BIT0;
/*PORTD|=(4<<3);*/PORTB|=(BIT1<<PORTB3);}}
else{if (LUIS3==BIT0){LUIS3=1;
/*PORTD&=~(4<<3);*/PORTB&=~(BIT1<<PORTB3);}}}
/*------------------------------------------------------------------*/
#endif